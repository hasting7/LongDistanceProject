## main/Kconfig.projbuild
```kconfig
menu "Long Distance Tracker"

    # ============================================================
    # Boot Settings
    # ============================================================

    menu "Boot Settings"

        choice WIFI_BOOT_MODE
            prompt "WiFi boot mode"
            default WIFI_BOOT_MODE_NORMAL

            config WIFI_BOOT_MODE_NORMAL
                bool "Normal"
                help
                    Use stored WiFi credentials if available.
                    If no stored credentials exist, enter provisioning mode.

            config WIFI_BOOT_MODE_FORCE_PROVISIONING
                bool "Force provisioning"
                help
                    Ignore and clear any stored WiFi credentials on boot.
                    Always enter WiFi provisioning mode.

            config WIFI_BOOT_MODE_DEFAULT
                bool "Use default WiFi"
                help
                    Ignore stored WiFi credentials and connect using the
                    default WiFi credentials configured in WiFi Settings.

        endchoice

        config UPDATE_SYSTEM_SCREENS
            bool "Force system screen download on boot"
            default n
            help
                Download updated system screens every time the device boots.

    endmenu


    # ============================================================
    # WiFi Settings
    # ============================================================

    menu "WiFi Settings"

        config WIFI_DEFAULT_SSID
            string "Default WiFi SSID"
            default ""
            help
                SSID of the WiFi network used when "Use default WiFi"
                is selected as the WiFi boot mode.

        config WIFI_DEFAULT_PASSWORD
            string "Default WiFi password"
            default ""
            help
                Password for the default WiFi network.

        config WIFI_MAXIMUM_RETRY
            int "Maximum WiFi connection retry attempts"
            default 5
            range 1 50
            help
                Maximum number of attempts made when connecting to WiFi
                before giving up.

    endmenu


    # ============================================================
    # Server Settings
    # ============================================================

    menu "Server Settings"

        choice SERVER_ENVIRONMENT
            prompt "Server environment"
            default SERVER_ENVIRONMENT_CLOUD

            config SERVER_ENVIRONMENT_LOCAL
                bool "Local"

            config SERVER_ENVIRONMENT_CLOUD
                bool "Cloud"

        endchoice

        config SERVER_LOCAL_IP
            string "Local server address"
            default "http://10.0.0.79"
            help
                Address of the local server.

        config SERVER_CLOUD_IP
            string "Cloud server address"
            default "https://benjaminhastings1211.github.io"
            help
                Address of the cloud server.

    endmenu


    # ============================================================
    # Device Settings
    # ============================================================

    menu "Device Settings"

        config DEVICE_VERSION
            string "Firmware version"
            default "1.0.0"

        config DEVICE_NAME
            string "Device name"
            default "LongDistanceTracker"
            help
                Name used to identify the device on the local network
                and during WiFi provisioning.

        config DEVICE_PASSWORD
            string "Device password"
            default "password"
            help
                Password used to protect the device's provisioning
                access point.

        config DARK_MODE
            bool "Dark Mode"
            default n
            help
                Should the display be rendered in dark mode?

        choice TIMEZONE
            prompt "Device Timezone"
            default TIMEZONE_EASTERN

            config TIMEZONE_EASTERN
                bool "Eastern"

            config TIMEZONE_CENTRAL
                bool "Central"

            config TIMEZONE_MOUNTAIN
                bool "Mountain"

            config TIMEZONE_PACIFIC
                bool "Pacific"

        endchoice

    endmenu


    # ============================================================
    # Display Settings
    # ============================================================

    menu "Display Settings"

        config SUCCESS_UPDATE_INTERVAL
            int "Successful update interval (seconds)"
            default 3600
            range 1 2147483647
            help
                How long the device should sleep after a successful update
                before waking and updating the display again.

        config FAILURE_UPDATE_INTERVAL
            int "Failed update interval (seconds)"
            default 300
            range 1 2147483647
            help
                How long the device should sleep after a failed update
                before waking and retrying the update.


    endmenu

endmenu
```
